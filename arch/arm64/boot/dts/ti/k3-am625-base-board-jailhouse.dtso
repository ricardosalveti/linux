// SPDX-License-Identifier: GPL-2.0
/*
 * Copyright (C) 2022 Texas Instruments Incorporated - http://www.ti.com/
 */

/dts-v1/;
/plugin/;

&reserved_memory {
	#address-cells = <2>;
	#size-cells = <2>;

	/*
	 * Reserve for Jailhouse hypervisor firmware and inmates.
	 * Must be in sync with jailhouse cell configurations.
	 */
	hyp_mem: jailhouse@dfa00000 {
		reg = <0x0 0xdfa00000 0x0 0x20600000>;
		alignment = <0x1000>;
		no-map;
	};
};

&main_uart1 {
	status = "disabled";
};

&sdhci0 {
	status = "disabled";
};
